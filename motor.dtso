/dts-v1/;
/plugin/;

/{
    compatible = "brcm,bcm2711";

    fragment@0 {
        // Configure the gpio pin controller
        target = <&gpio>;
        __overlay__ {
                pin_state: motor-pin@0 {
                        brcm,pins = <18 23>; // gpio number
                        brcm,function = <1>; // 0 = input, 1 = output
                        brcm,pull = <0>; // 0 = none, 1 = pull down, 2 = pull up
                };
        };
    };

    fragment@1 {
        target-path = "/";
        __overlay__ {
            motor: motor@0 {
                compatible = "reterminal_motor";
                pinctrl-names = "default";
                pinctrl-0 = <&pin_state>;
                gpios = <&gpio 18 0>,
                        <&gpio 23 0>;
                status = "okay";
            };
        };
    };
};

